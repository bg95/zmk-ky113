/*
 * Copyright (c) 2023 The ZMK Contributors
 *
 * SPDX-License-Identifier: MIT
 */

#include "ky113.dtsi"

/ {
    chosen {
        zmk,kscan = &kscan;
    };

    kscan: kscan {
        compatible = "zmk,kscan-gpio-matrix";
        wakeup-source;

        diode-direction = "col2row";

        row-gpios
            = <&gpio0 31 (GPIO_PULL_DOWN | GPIO_ACTIVE_HIGH)>
            , <&gpio0 24 (GPIO_PULL_DOWN | GPIO_ACTIVE_HIGH)>
            , <&gpio0  9 (GPIO_PULL_DOWN | GPIO_ACTIVE_HIGH)>
            , <&gpio0 10 (GPIO_PULL_DOWN | GPIO_ACTIVE_HIGH)>
            , <&gpio1 11 (GPIO_PULL_DOWN | GPIO_ACTIVE_HIGH)>
            , <&gpio1 13 (GPIO_PULL_DOWN | GPIO_ACTIVE_HIGH)>
            ;

        col-gpios
            = <&gpio0 29 GPIO_ACTIVE_HIGH>
            , <&gpio0  2 GPIO_ACTIVE_HIGH>
            , <&gpio1 15 GPIO_ACTIVE_HIGH>
            , <&gpio0 22 GPIO_ACTIVE_HIGH>
            ;
    };

};

&default_transform {
    col-offset = <17>;
};

